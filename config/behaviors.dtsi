/ {
  behaviors {
    modquad_backslash: modquad_backslash {
      compatible = "zmk,behavior-modquad";
      label = "Backslash four-mod key";
      #binding-cells = <0>;
      bindings = < 0x2D, 0x38, 0x2E, 0x64 >;
    };
  };
};
